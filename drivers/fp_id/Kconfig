## drivers/fp_id/Kconfig
```kconfig
#
# vivo-compatible fingerprint id node
#
menuconfig FP_ID
	bool "Legacy vivo /sys/fp_id/fp_id node"
	help
	  Provide the /sys/fp_id/fp_id character node that vivo's fingerprint
	  service (PropertiesCreator, vivo-services.jar) reads to decide which
	  fingerprint hardware is present.

	  The file contains one line of the form

	      <type>_<manufacturer>_<module>

	  where <type> is one of common / optical / udfp / ultrasonic / sidefp.

	  The first field is a keyword, NOT a number: "common" maps to
	  sensorType 1 (rear), "1" would be parsed as UNKNOWN (type 0).

	  The default content is compiled into the driver
	  (drivers/fp_id/fp_id.c, FP_ID_DEFAULT = "common_fpc_fpc1020").
	  It can be changed at runtime by writing to the node, or at boot from
	  device tree via the "vivo,fp-id" property.

	  If unsure, say N.
```

## drivers/mihw/Kconfig
```kconfig
config MILLET
	bool "Millet framework driver"
	select MIHW
	select ANDROID_VENDOR_HOOKS
	select TRACEPOINTS
	default n
	help
	  Enable Xiaomi Millet framework integration.

config MILLET_CGROUP
	tristate "frozen framework cgroup"
	depends on MILLET
	default y if MILLET

config MILLET_SIG
	tristate "frozen framework signal"
	depends on MILLET
	default y if MILLET

config MILLET_BINDER
	tristate "frozen framework binder"
	depends on MILLET
	default y if MILLET

config MILLET_PKG
	tristate "frozen framework pkg"
	depends on MILLET
	default y if MILLET

config MILLET_BINDER_GKI
	tristate "frozen framework binder gki"
	depends on MILLET
	default y if MILLET

config MILLET_CORE
	tristate "frozen framework core"
	depends on MILLET
	default y if MILLET

config MILLET_HS
	tristate "frozen framework hs"
	depends on MILLET
	default y if MILLET
```

## drivers/net/oplus_vnet/Kconfig
```kconfig
# SPDX-License-Identifier: GPL-2.0-only
# Copyright (C) 2020-2022 Oplus. All rights reserved.

config OPLUS_FEATURE_VIRTUAL_NET
	tristate "Oplus virtual net device for datashare"
	help
	  This driver provides a virtual network device for data sharing
	  between network interfaces. It creates ovnet%d devices that can
	  be used with iproute2 to redirect packets.

	  To compile this driver as a module, choose M here: the
	  module will be called oplus_vnet.
```

## drivers/ohos/Kconfig
```kconfig
menu "OpenHarmony / HarmonyOS userspace support"

config OHOS_BRINGUP_NOREBOOT
	bool "Refuse HarmonyOS init panic reboots (hmos.noreboot=1)"
	default n

config OHOS_BRINGUP_PERMISSIVE
	bool "Pin SELinux permissive (hmos.permissive=1)"
	depends on SECURITY_SELINUX_DEVELOP
	default n

config OHOS_FS_EMU
	bool "Emulate hmdfs/sharefs mounts with tmpfs + bind mounts"
	default n
	help
	  HarmonyOS storage_daemon needs the hmdfs and sharefs filesystems to
	  start a user.  Emulate their local (non-distributed) views.

endmenu
```
